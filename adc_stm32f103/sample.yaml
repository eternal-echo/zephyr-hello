## adc_stm32f103/sample.yaml
```yaml
sample:
  name: STM32F103 ADC Sample
  description: Periodically sample ADC1 channel 0 on Nucleo-F103RB and print raw and millivolt values.
common:
  tags:
    - adc
  depends_on: adc

tests:
  sample.apps.adc_stm32f103:
    platform_allow:
      - nucleo_f103rb
    harness: console
    timeout: 10
    harness_config:
      type: multi_line
      regex:
        - "ADC reading\\[\\d+\\]:"
        - "- .+, channel \\d+: -?\\d+"
```
